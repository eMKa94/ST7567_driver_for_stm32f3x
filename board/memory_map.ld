/*
*/
MEMORY
{
  BOOTLOADER_FLASH  (rx)    : ORIGIN = 0x8000000,   LENGTH = 2K
  APPLICATION_FLASH (rx)    : ORIGIN = 0x8000000,   LENGTH = 254K
  RAM               (xrw)   : ORIGIN = 0x20000000,   LENGTH = 32K
}

__BOOTLOADER_FLASH_start__      = ORIGIN(BOOTLOADER_FLASH);
__BOOTLOADER_FLASH_size__       = LENGTH(BOOTLOADER_FLASH);
__APPLICATION_FLASH_start__     = ORIGIN(APPLICATION_FLASH);
__APPLICATION_FLASH_size__      = LENGTH(APPLICATION_FLASH);